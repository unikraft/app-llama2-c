## l2e_boot/l2e_sources/l2e_os/Kconfig
```kconfig
# SPDX-License-Identifier: GPL-2.0-only
#
# L2E OS Driver
#

config L2E_OS_DRIVER
	tristate "L2E OS Driver: LLAMA2 Binary Loader"
	select USERMODE_DRIVER
	default y
```
